## sdkconfig.defaults
```kconfig
# FestStefan — real hardware config (no Wokwi)
# Bluetooth disabled for Task 1 (tone test only)
CONFIG_BT_ENABLED=n

# Flash size — 4MB (standard for ESP32 AudioKit)
CONFIG_ESPTOOLPY_FLASHSIZE_4MB=y
```

## sdkconfig.defaults.bak
```kconfig
# Bluetooth Classic enabled
CONFIG_BT_ENABLED=y
CONFIG_BT_CLASSIC_ENABLED=y
CONFIG_BT_BLE_ENABLED=n

# HFP Hands-Free (we are the HF unit)
CONFIG_BT_HFP_ENABLE=y
CONFIG_BT_HFP_CLIENT_ENABLE=y

# SPP (Serial Port Profile — useful for debug/future use)
CONFIG_BT_SPP_ENABLED=y

# A2DP disabled (we don't need music streaming)
CONFIG_BT_A2DP_ENABLE=n
```
